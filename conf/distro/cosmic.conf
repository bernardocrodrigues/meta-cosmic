## conf/distro/cosmic.conf
```bitbake
require conf/distro/poky.conf

# Distro metadata override
DISTRO = "cosmic"
DISTRO_NAME = "CosmicOS"
DISTRO_VERSION = "0.2.0"
DISTRO_CODENAME = "Dust"
SDK_VENDOR = "-cosmicsdk"
SDK_VERSION ="${DISTRO_VERSION}"
MAINTAINER = "Bernardo Rodrigues <bernardocrodrigues@live.com>"
TARGET_VENDOR = "-cosmic"
DISTRO_TYPE = "debug"

# Prefer deb over ipk for a yet to be tested Debian compatibility
#ANGSTROM_PKG_FORMAT = "deb"
# INHERIT_remove = "package_ipk"
# INHERIT_append = "package_deb"

# ANGSTROM_FEED_CONFIGS ?= "angstrom-feed-configs"
# EXTRAOPKGCONFIG = "opkg-config-base ${ANGSTROM_FEED_CONFIGS}"
# ANGSTROM_IPK_UPDATE_ALTERNATIVES ?= "update-alternatives-opkg"
# DISTRO_UPDATE_ALTERNATIVES = "${ANGSTROM_IPK_UPDATE_ALTERNATIVES}"

# we need the same provider for opkg and u-a
# PREFERRED_PROVIDER_virtual/update-alternatives-native ?= "opkg-utils-native"
# PREFERRED_PROVIDER_virtual/update-alternatives = "opkg-utils"
# VIRTUAL-RUNTIME_update-alternatives = "${ANGSTROM_IPK_UPDATE_ALTERNATIVES}"



# Sets distro features and base packages
# Enable virtualization, aufs feature needed for Docker runtime
#COSMIC_DEFAULT_DISTRO_FEATURES = "ssh-server-openssh systemd"
#COSMIC_EXTRA_RDEPENDS = "packagegroup-core-ssh-openssh"
#COSMIC_DEFAULT_EXTRA_RRECOMMENDS = ""

#DISTRO_FEATURES += "${COSMIC_DEFAULT_DISTRO_FEATURES}"
#DISTRO_EXTRA_RDEPENDS += " ${COSMIC_EXTRA_RDEPENDS}"
#DISTRO_EXTRA_RRECOMMENDS += " ${COSMIC_DEFAULT_EXTRA_RRECOMMENDS}"

# DISTRO_EXTRA_RDEPENDS_remove = "angstrom-libc-fixup-hack"
#DISTRO_FEATURES= "ext2 ipv4 ipv6 largefile pcmcia usbgadget usbhost wifi nfs zeroconf largefile systemd ldconfig"

DISTRO_FEATURES= "virtualization systemd"

DISTRO_FEATURES_BACKFILL_CONSIDERED += "sysvinit"
VIRTUAL-RUNTIME_init_manager = "systemd"
VIRTUAL-RUNTIME_initscripts = "systemd-compat-units"

#PREFERRED_VERSION_linux-raspberrypi ??= "5.3.%"
```

## conf/layer.conf
```bitbake
# We have a conf and classes directory, add to BBPATH
BBPATH .= ":${LAYERDIR}"

# We have recipes-* directories, add to BBFILES
BBFILES += "${LAYERDIR}/recipes-*/*/*.bb \
            ${LAYERDIR}/recipes-*/*/*.bbappend"

BBFILE_COLLECTIONS += "meta-cosmic"
BBFILE_PATTERN_meta-cosmic = "^${LAYERDIR}/"
BBFILE_PRIORITY_meta-cosmic = "8"

LAYERDEPENDS_meta-cosmic = "core"
LAYERSERIES_COMPAT_meta-cosmic = "warrior thud"
```
